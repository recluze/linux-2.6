## security/basc/Kconfig
```kconfig
config SECURITY_BASC
	bool "BASC Support"
	depends on SECURITY
	select NETWORK_SECMARK
	default n
	help
	  This selects Behavioral Attestation through System Calls framework.
          see recluze.wordpress.com for more details
```
